#include <REGX52.H>

void Delay(unsigned int xms);
void _74HC595_WriteByte(unsigned char byte);
void LED(unsigned char Y,DATA);
void LED_Init();



sbit RCK=P3^5; 	//RCLK
sbit SCK=P3^6; 	//SRCL
sbit SER=P3^4; 	//SER
//????
unsigned char code DH[]=
	{
		0x00,0x0E,0x1B,0x7F,0x7F,0x1B,0x0E,0x00,
		0x00,0x04,0x0C,0x18,0x7F,0x7F,0x1B,0x0E,
		0x00,0x08,0x0C,0x05,0x7F,0x7F,0x1E,0x0C,
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		0x00,0x00,0x00,0x31,0x0A,0x7C,0x7E,0x0D,
	};

	void main()
{
	unsigned char i,py=0,pl=0;
	LED_Init();
	while(1)
	{
		for(i=0;i<8;i++)
		{
			LED(i,DH[i+py]);
		}
		pl++;
		if(pl>25)
		{
			pl=0;
			py+=8;
			if(py>10000)
			{
				py=0;
			}
		}

	}
}
//??xms
void Delay(unsigned int xms)
{

		while(xms--)
		{
					unsigned char i, j;

			i = 2;
			j = 199;
			do
			{
				while (--j);
			} while (--i);
	
		}
}
void _74HC595_WriteByte(unsigned char byte)
{
	unsigned char i;
	for(i=0;i<8;i++)
	{
		SER=byte&(0x80>>i);
		SCK=1;
		SCK=0;
	}
		RCK=1;
		RCK=0;
}
//led????
void LED(unsigned char Y,DATA)
{
	_74HC595_WriteByte(DATA);
	P0=~(0X80>>Y);
	Delay(1);
	P0=0XFF;
}
//led???
void LED_Init()
{
		SCK=0;
		RCK=0;
}


